## main/Kconfig.projbuild
```kconfig
menu "Audio Brick features"
    # Optional features. A feature that is switched off is not compiled: no code, no web endpoints, no page card.
    # Change with `idf.py menuconfig` (Audio Brick features) or put CONFIG_AB_FEATURE_xxx=y/n in sdkconfig.defaults
    # (then delete sdkconfig, which is only read as a whole when it does not exist).
    # Core parts that are always built: mixer, test tone, stored clips and player, web page with login, OTA, safe mode.

    config AB_FEATURE_EQ
        bool "Speaker EQ (six software filters)"
        default y
        help
            Parametric EQ applied to every source. Small.

    config AB_FEATURE_CLIPS
        bool "Stored clips and the player (MP3/WAV on the flash file system)"
        default y
        help
            The clip manager on the web page, the transport buttons (play, pause, next, previous) and the FAT partition for the files.
            The ambient scene and announcements need it (they use the same decoder).

    config AB_FEATURE_ANNOUNCE
        bool "Announcements (POST /announce) and ducking of a running stream"
        default y
        depends on AB_FEATURE_CLIPS
        help
            Plays an uploaded sound from memory over whatever is playing, for example a Home Assistant text-to-speech message,
            and lowers the stream meanwhile.

    config AB_FEATURE_AMBIENT
        bool "Ambient scene (looping background plus random events)"
        default y
        depends on AB_FEATURE_CLIPS
        help
            Uses the background and event mixer channels and a second MP3 decoder.

    config AB_FEATURE_VBAN
        bool "VBAN receiver (Voicemeeter network audio, UDP 6980)"
        default y
        help
            Lets Voicemeeter or any VBAN sender play on the board. Works on Windows 11 (Voicemeeter's drivers are signed).

    config AB_FEATURE_SCREAM
        bool "Scream receiver (UDP 4010, unicast or multicast)"
        default n
        help
            The firmware side works, but the Scream Windows driver cannot be installed normally on Windows 11: its
            certificate expired in 2023 and no signed build exists, so installing it needs Secure Boot off and Test Mode.
            See docs/windows-setup.md. Enable this only if you have a working Scream sender (for example Linux or a
            Windows machine in Test Mode).

    config AB_FEATURE_RADIO
        bool "Internet radio (MP3 streams over HTTP and HTTPS)"
        default y
        help
            Pulls in the HTTP client and TLS, which adds about 400 KB to the image and about 30 KB of heap while playing.

    config AB_FEATURE_SYNTH
        bool "OSC synthesizer (UDP 9000)"
        default y
        help
            Eight-voice synthesizer controlled by OSC messages.

    config AB_FEATURE_MDNS
        bool "mDNS (reach the board as audiobrick.local)"
        default y
        help
            Advertises the hostname "audiobrick" and the web, OSC and VBAN services on the local network.

    config AB_FEATURE_BLUETOOTH
        bool "Bluetooth audio (A2DP sink, ESP32 only)"
        default y
        depends on IDF_TARGET_ESP32
        help
            Lets a phone or PC play music on the Brick. Adds about 300 KB of code and, once switched on from the web page,
            roughly 60 KB of internal RAM (the stack lives in PSRAM where it can). Classic Bluetooth only exists on the ESP32, not the S3.

    config AB_FEATURE_WIFI
        bool "Wi-Fi client (second network interface)"
        default y
        help
            Join a remembered Wi-Fi network as a second interface next to Ethernet (both use DHCP). Networks are scanned, added and
            chosen on the web page. Wi-Fi stays off until a network is added. Needs about 300 KB of code and 40 KB of internal RAM while on.

    config AB_FEATURE_TCPSTREAM
        bool "TCP audio stream receiver (port 4010)"
        default y
        help
            The receiver behind tools/stream.py and tools/brick_sender.py (PC sound through the virtual cable).

    config AB_FEATURE_POWERSAVE
        bool "Amp power saving (Hi-Z after a while, power-down after longer)"
        default y
        help
            The idle timers and the /power endpoint. Without it the amp stays awake (muted when nothing plays).

    config AB_FEATURE_SNTP
        bool "Network clock (SNTP)"
        default y
        help
            Sets the clock from the internet so the page can show the time. Needed by any future time-of-day feature.

    config AB_FEATURE_SAFEMODE
        bool "Safe mode after repeated crashes"
        default y
        help
            After three boots in a row that did not stay up for 30 s, the optional features are held off so the page and OTA still work.

    config AB_FEATURE_BOOTINFO
        bool "Restart diagnostics (why did the board restart?)"
        default y
        help
            Remembers the reset reason, counts boots and abnormal restarts, and shows them on the page.

endmenu
```

## sdkconfig.defaults.btdebug
```kconfig
CONFIG_BT_LOG_L2CAP_TRACE_LEVEL_DEBUG=y
CONFIG_BT_LOG_SDP_TRACE_LEVEL_DEBUG=y
CONFIG_BT_LOG_AVDT_TRACE_LEVEL_DEBUG=y
CONFIG_BT_LOG_A2D_TRACE_LEVEL_DEBUG=y
CONFIG_BT_LOG_AVRC_TRACE_LEVEL_DEBUG=y
CONFIG_BT_LOG_BTA_TRACE_LEVEL_DEBUG=y
CONFIG_BT_LOG_BTM_TRACE_LEVEL_DEBUG=y
CONFIG_BT_LOG_GAP_TRACE_LEVEL_DEBUG=y
CONFIG_BT_LOG_BTIF_TRACE_LEVEL_DEBUG=y
CONFIG_BT_LOG_BTC_TRACE_LEVEL_DEBUG=y
CONFIG_LOG_DEFAULT_LEVEL_DEBUG=y
CONFIG_LOG_MAXIMUM_LEVEL_DEBUG=y
```
